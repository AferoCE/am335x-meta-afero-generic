## conf/distro/include/branding-afero-ti.inc
```bitbake
PREFERRED_PROVIDER_virtual/kernel = "linux-afero${ARAGO_KERNEL_SUFFIX}"
PREFERRED_PROVIDER_virtual/kernel_am335x-evm = "linux-afero${ARAGO_KERNEL_SUFFIX}"
PREFERRED_PROVIDER_virtual/kernel_am437x-evm = "linux-afero${ARAGO_KERNEL_SUFFIX}"
PREFERRED_PROVIDER_virtual/kernel_am57xx-evm = "linux-afero${ARAGO_KERNEL_SUFFIX}"
PREFERRED_PROVIDER_virtual/kernel_keystone = "linux-afero${ARAGO_KERNEL_SUFFIX}"
PREFERRED_VERSION_linux-afero = "4.4%"
```

## conf/layer.conf
```bitbake
# We have a conf and classes directory, add to BBPATH
BBPATH := "${BBPATH}:${LAYERDIR}"

# We have a recipes directory, add to BBFILES
BBFILES := "${BBFILES} ${LAYERDIR}/recipes-*/*/*.bb \
        ${LAYERDIR}/recipes-*/*/*.bbappend"

BBFILE_COLLECTIONS += "afero"
BBFILE_PATTERN_afero := "^${LAYERDIR}/"
BBFILE_PRIORITY_afero = "6"
```
